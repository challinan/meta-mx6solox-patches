## conf/bblayers.conf
```bitbake
MELDIR = "/home/chris/mgc/embedded/mel/2014.12.332"

# LAYER_CONF_VERSION is increased each time build/conf/bblayers.conf
# changes incompatibly
LCONF_VERSION = "6"

TOPDIR := "${@os.path.dirname(os.path.dirname(FILE))}"
BBPATH = "${TOPDIR}:${HOME}/.oe"
BBFILES ?= ""

BBLAYERS = "\
    /scratch/sandbox/meta-mytools \
    /scratch/sandbox/meta-mx6solox-patches \
    /home/chris/mgc-birch/embedded/mel/2014.12.332/meta-oe/meta-ruby \
    /home/chris/mgc/embedded/mel/2014.12.332/meta-qt5 \
    /home/chris/mgc/embedded/mel/2014.12.332/update-mel-2 \
    /home/chris/mgc/embedded/mel/2014.12.332/update-mel-1 \
    /home/chris/mgc/embedded/mel/2014.12.332/meta-mentor-mx6solox-memf \
    /home/chris/mgc/embedded/mel/2014.12.332/meta-mentor-private \
    /home/chris/mgc/embedded/mel/2014.12.332/meta-mentor/meta-mel \
    /home/chris/mgc/embedded/mel/2014.12.332/meta-mx6solox \
    /home/chris/mgc/embedded/mel/2014.12.332/meta-sourcery \
    /home/chris/mgc/embedded/mel/2014.12.332/meta-mentor/meta-mentor-staging \
    /home/chris/mgc/embedded/mel/2014.12.332/meta-oe/meta-python \
    /home/chris/mgc/embedded/mel/2014.12.332/meta-oe/meta-filesystems \
    /home/chris/mgc/embedded/mel/2014.12.332/poky/meta-yocto \
    /home/chris/mgc/embedded/mel/2014.12.332/meta-oe/meta-networking \
    /home/chris/mgc/embedded/mel/2014.12.332/meta-fsl-arm \
    /home/chris/mgc/embedded/mel/2014.12.332/poky/meta \
    /home/chris/mgc/embedded/mel/2014.12.332/meta-mentor/meta-mel-support \
    /home/chris/mgc/embedded/mel/2014.12.332/meta-tracing \
    /home/chris/mgc/embedded/mel/2014.12.332/meta-oe/meta-oe \
"
```

## conf/layer.conf
```bitbake
BBPATH .= ":${LAYERDIR}"

BBFILES += "${LAYERDIR}/recipes*/*/*.bb \
            ${LAYERDIR}/recipes*/*/*.bbappend"

BBFILE_COLLECTIONS += "mx6solox-patches"
BBFILE_PATTERN_mx6solox-patches := "^${LAYERDIR}/"
BBFILE_PRIORITY_mx6solox-patches = "29"

LAYERDEPENDS_mx6solox-patches = "core mel qt5-layer ruby-layer tracing-layer"
```
